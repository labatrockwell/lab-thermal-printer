#include "SoftwareSerial.h"
#include "Adafruit_Thermal.h"
#include "Stream.h"

/**
 * Declare which pins to communicate to the printer over
 */
int printer_RX_Pin = 5; // green wire
int printer_TX_Pin = 6; // yellow wire

//must be multiple of 2
//must be >= 4
int checkSize = 14*4;

/**
 * The Adafruit thermal printer library stipulates 384 pixel max width.
 * Currently this is a multiple of 8, which simplifies some logic.
 * If this changes to not be a multiple of 8, some code will need to be
 * added. See notes in loop().
 */
const int maxWidth = 384;
const int pixelSize = 1;
const int arraySize = maxWidth / 8 * pixelSize;
  //maxWidth is a multiple of 8, so we don't need to worry about 
  //losing data with rounding errors
//  uint8_t bitmap[arraySize];
 uint8_t bitmap[] = {
   0xFF,0x0,0xFF,0x0,0xFF,0x0,0xFF,0x0,0xFF,0x0,0xFF,0x0,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0x0,

0xFF,0x0,0xFF,0x0,0xFF,0x0,0xFF,0x0,0xFF,0x0,0xFF,0x0,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0x0,
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0xF,0x0,0xF,0x0,0xF,0x0,0xF,0x0,0xF,0x0,0xF,0x0,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0x0
  };
  
  uint8_t test[] = {
  0x00,0x00,0x00,0x00,0x00,0xe0,0x00,0x00,0x00,0x00,
  0x00,0x00,0x00,0x00,0x01,0xf0,0x00,0x00,0x00,0x00,
  0x00,0x00,0x00,0x00,0x03,0xf0,0x00,0x00,0x00,0x00,
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  0x00,0x00,0x00,0x00,0x00,0x00,0x1c,0x00,0x00,0x00};

/**
 * Used to keep track of which weft line we are on
 */
int line = 0;

/**
 * Initialize the thermal printer
 */
Adafruit_Thermal printer(printer_RX_Pin, printer_TX_Pin);

void setup(){
  printer.begin();
  Serial.begin(9600);
}

/**
 * Houndstooth uses alternating 4 dark/4 light threads
 * in both the warp and weft. over 2, under 2.
 */
void loop(){
  //Stream s = new Stream();
  //s.print(test);
  //printer.printBitmap(75,75,test, false);
  //printer.printBitmap(maxWidth, 8*pixelSize, bitmap, false);
  //delay(500);
  //return;
  boolean warpBlack = true;//re-evaluated each step
  boolean weftBlack = line < checkSize;//stays constant for this loop
  
  //weft pattern repeats every 4 lines
  //this is also re-evaluated each step since it controls weftOver param
  int weftCounter = line % checkSize;
  
  //under, over, over, under, so we xor the first and second bits
  //re-evaluated each step
  boolean weftOver =  (weftCounter ^ (weftCounter >> 1)) & 1;
  //Serial.print(line);
  //Serial.print(", ");
  //Serial.println(weftBlack);
  
  int bitmapIndex = 0;
  uint8_t curr = 0;
  uint8_t currCounter = 0;
  for(int column = 0; column < maxWidth; column++){
    warpBlack = ((column/pixelSize) % (checkSize*2)) < checkSize;
    weftOver = (weftCounter == 0 ? false : (weftCounter <= checkSize/2));//(weftCounter ^ (weftCounter >> 1)) & 1;
    
    boolean isBlack = (weftOver ? weftBlack : warpBlack);
    curr |= (isBlack ? 1 : 0);
    currCounter++;
    if (currCounter == 8){
      for(int i = 0; i < pixelSize; i++){
        bitmap[bitmapIndex + i * (arraySize/pixelSize)] = curr;
        //bitmap[bitmapIndex + arraySize/2] = curr;
      }
      bitmapIndex++;
      //Serial.print(bitmap[bitmapIndex - 1]);
      //Serial.print(' ');
      curr = 0;
      currCounter = 0;
    } else {
      curr = curr << 1;
    }
    
    //repeats every 4 columns
    if ((column % pixelSize) == pixelSize - 1){
      weftCounter--;// = (weftCounter - 1); % checkSize;
      if (weftCounter < 0){
        weftCounter = checkSize - 1;
      }
    }
  }
  //maxWidth is a multiple of 8, 
  //so we don't need to worry about having leftover bits 
  //to put in the array
    
  for(int i = 0; i < arraySize; i++){
    Serial.print("0x");
    Serial.print(bitmap[i], HEX);
    Serial.print(',');
    if ((i % (arraySize/pixelSize)) == arraySize/pixelSize - 1){
      Serial.println();
    }
  }
  
  printer.printBitmap(maxWidth,pixelSize,bitmap, false);
  Serial.println();
  //delay(100);
  //increment line
  //we only need to count up to 8 since it repeats every 8 rows
  line = (line + 1) % (checkSize*2);
}
